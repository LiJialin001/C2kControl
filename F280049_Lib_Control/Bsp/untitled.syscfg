/**
 * @cliArgs --device "F28004x" --package "F28004x_64PM" --part "F28004x_64PM" --product "C2000WARE@4.01.00.00"
 * @versions {"tool":"1.14.0+2667"}
 */

/**
 * Import the modules used in this configuration.
 */
const gpio  = scripting.addModule("/driverlib/gpio.js", {}, false);
const gpio1 = gpio.addInstance();

/**
 * Write custom configuration values to the imported modules.
 */
gpio1.$name             = "myGPIO0";
gpio1.writeInitialValue = true;
gpio1.initialValue      = 1;
gpio1.direction         = "GPIO_DIR_MODE_OUT";
gpio1.gpioPin.$assign   = "ball.35";
